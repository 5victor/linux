## arch/arm/mach-s3c2440/Kconfig
```kconfig
if ARCH_S3C2440

menu "S3C2440 MACHINES"

config MACH_MINI2440
	bool "mini2440 board"
	help
		mini2440 board support

config MACH_MINI2440_LEDS_TIMER
	bool "mini2440 leds timer"
	depends on MACH_MINI2440
	select LEDS
	select LEDS_TIMER
	help
		mini2440 leds timer support


endmenu

endif
```
